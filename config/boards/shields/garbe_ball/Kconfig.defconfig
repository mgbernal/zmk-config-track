## config/boards/shields/garbe_ball/Kconfig.defconfig
```kconfig
config ZMK_KEYBOARD_NAME
    default "garbe_ball"

config ZMK_SPLIT_ROLE_CENTRAL
    default y
```

## config/boards/shields/garbe_ball/Kconfig.shield
```kconfig
# Copyright (c) 2020 Pete Johanson
# SPDX-License-Identifier: MIT

config SHIELD_GARBE_BALL
	def_bool $(shields_list_contains,garbe_ball)
```

## config/boards/shields/kyria/Kconfig.defconfig
```kconfig
config ZMK_KEYBOARD_NAME
    default "kyria"

config ZMK_SPLIT_ROLE_CENTRAL
    default y
```

## config/boards/shields/kyria/Kconfig.shield
```kconfig
# Copyright (c) 2020 Pete Johanson
# SPDX-License-Identifier: MIT

config SHIELD_KYRIA_LEFT
	def_bool $(shields_list_contains,kyria_left)
```

## config/boards/shields/m330/Kconfig.defconfig
```kconfig
if SHIELD_KYRIA_LEFT

config ZMK_KEYBOARD_NAME
    default "kyria"

config ZMK_SPLIT_ROLE_CENTRAL
    default y

endif

if SHIELD_KYRIA_LEFT || SHIELD_KYRIA_RIGHT

config ZMK_SPLIT
    default y

endif
```
